PROVIDE(isr_irq0 = isr_hardfault);
PROVIDE(isr_irq1 = isr_hardfault);
PROVIDE(isr_irq2 = isr_hardfault);
PROVIDE(isr_irq3 = isr_hardfault);
PROVIDE(isr_irq4 = isr_hardfault);
PROVIDE(isr_irq5 = isr_hardfault);
PROVIDE(isr_irq6 = isr_hardfault);
PROVIDE(isr_irq7 = isr_hardfault);
PROVIDE(isr_irq8 = isr_hardfault);
PROVIDE(isr_irq9 = isr_hardfault);
PROVIDE(isr_irq10 = isr_hardfault);
PROVIDE(isr_irq11 = isr_hardfault);
PROVIDE(isr_irq12 = isr_hardfault);
PROVIDE(isr_irq13 = isr_hardfault);
PROVIDE(isr_irq14 = isr_hardfault);
PROVIDE(isr_irq15 = isr_hardfault);
PROVIDE(isr_irq16 = isr_hardfault);
PROVIDE(isr_irq17 = isr_hardfault);
PROVIDE(isr_irq18 = isr_hardfault);
PROVIDE(isr_irq19 = isr_hardfault);
PROVIDE(isr_irq20 = isr_hardfault);
PROVIDE(isr_irq21 = isr_hardfault);
PROVIDE(isr_irq22 = isr_hardfault);
PROVIDE(isr_irq23 = isr_hardfault);
PROVIDE(isr_irq24 = isr_hardfault);
PROVIDE(isr_irq25 = isr_hardfault);
PROVIDE(isr_irq26 = isr_hardfault);
PROVIDE(isr_irq27 = isr_hardfault);
PROVIDE(isr_irq28 = isr_hardfault);
PROVIDE(isr_irq29 = isr_hardfault);

sam3x_iomem_PIOA = 0x400E0E00;
sam3x_iomem_PIOB = 0x400E1000;
sam3x_iomem_PIOC = 0x400E1200;
sam3x_iomem_PIOD = 0x400E1400;
sam3x_iomem_PIOE = 0x400E1600;
sam3x_iomem_PIOF = 0x400E1800;
sam3x_iomem_PMC = 0x400E0600;
sam3x_iomem_EEFC0 = 0x400E0A00;
sam3x_iomem_EEFC1 = 0x400E0C00;
sam3x_iomem_WDC = 0x400E1A50;
sam3x_iomem_TC0 = 0x40080000;
sam3x_iomem_TC1 = 0x40084000;
sam3x_iomem_TC2 = 0x40088000;
